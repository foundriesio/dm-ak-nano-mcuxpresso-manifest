## west.yml
```yaml
# The west manifest file (west.yml) for MCUXpresso SDK overall delivery.
#
# The per-workspace west configuration file, ${workspace_path}/.west/config,
# specifies the path of the project containing this manifest file, the
# path is relative to the workspace location ${workspace_path}.
#
#     [manifest]
#     path = core
#
# See the west documentation for more information:
#
# https://docs.zephyrproject.org/latest/guides/west/index.html

manifest:

  remotes:
    - name: nxpmicro
      url-base: https://github.com/nxp-mcuxpresso
    - name: nxp
      url-base: https://github.com/NXP
    - name: freertos
      url-base: https://github.com/FreeRTOS/
    - name: aws
      url-base: https://github.com/aws/

  defaults:
    remote: nxpmicro

  projects:
    - name: mcux-sdk
      revision: MCUX_2.14.0_UPDATE
      path: core

    - name: FreeRTOS-Kernel
      revision: MCUX_2.14.0
      path: rtos/freertos/freertos_kernel

    - name: Unity
      path: middleware/unity
      revision: v2.5.2
      url: https://github.com/ThrowTheSwitch/Unity.git

    - name: mbedtls
      path: middleware/mbedtls
      revision: MCUX_2.14.0-fio
      url: https://github.com/detsch/mcuxpresso-mbedtls.git

    - name: lwip
      path: middleware/lwip
      revision: MCUX_2.14.0

    - name: CMSIS_5
      path: middleware/CMSIS_5
      revision: MCUX_2.14.0

    - name: coreJSON
      path: middleware/freertos/coreJSON
      revision: v3.0.2
      remote: freertos

    - name: coreHTTP
      path: middleware/freertos/coreHTTP
      revision: v2.1.0
      remote: freertos

    - name: corePKCS11
      path: middleware/freertos/corePKCS11
      revision: v3.4.0
      remote: freertos

    - name: pkcs11
      path: middleware/pkcs11
      revision: v2.40_errata01
      # remote: aws
      url: https://github.com/amazon-freertos/pkcs11

    - name: amazon-freertos
      path: rtos/amazon-freertos
      revision: "202203.00"
      remote: aws

    - name: backoffAlgorithm
      path: middleware/freertos/backoffAlgorithm
      revision: "v1.2.0"
      remote: freertos

    - name: http-parser
      path: middleware/http-parser
      revision: "v2.9.4"
      url: https://github.com/nodejs/http-parser.git

    - name: dm-ak-nano-mcuxpresso
      path: foundriesio/dm-ak-nano-mcuxpresso
      revision: 7d56193e7758384fa9bec173ef7ffd067d23ffd0
      url: https://github.com/foundriesio/dm-ak-nano-mcuxpresso.git

    - name: aktualizr-nano
      path: foundriesio/aktualizr-nano
      revision: f306b363142594c3604dbd0769d4df60b5bafd18
      url: https://github.com/foundriesio/aktualizr-nano.git

    - name: libtufnano
      path: foundriesio/libtufnano
      revision: b4ee4b5af914e11e0654a475f83758786f525ec9
      url: https://github.com/foundriesio/libtufnano.git

    - name: plug-and-trust
      path: middleware/plug-and-trust
      revision: "v04.03.01"
      remote: nxp

    - name: inih
      path: middleware/inih
      revision: r56
      url: https://github.com/benhoyt/inih.git

    - name: coreMQTT-Agent
      path: middleware/coreMQTT-Agent
      revision: v1.1.0
      remote: freertos

    - name: coreMQTT
      path: middleware/coreMQTT
      revision: v1.2.0
      remote: freertos

  self:
    path: poc
```
